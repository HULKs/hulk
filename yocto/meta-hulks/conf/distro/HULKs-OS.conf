## yocto/meta-hulks/conf/distro/HULKs-OS.conf
```bitbake
require conf/distro/nao-core-minimal.conf

DISTRO = "HULKs-OS"
DISTRO_NAME = "HULKs-OS"
# increase at least minor version for sdk updates
DISTRO_VERSION = "5.0.0"
# cut the patch version -> there are no patch versions of the sdk
SDK_VERSION = "${@d.getVar('DISTRO_VERSION')[0:d.getVar('DISTRO_VERSION').rfind('.')]}"
```

## yocto/meta-hulks/conf/layer.conf
```bitbake
# We have a conf and classes directory, add to BBPATH
BBPATH .= ":${LAYERDIR}"

# We have recipes-* directories, add to BBFILES
BBFILES += "${LAYERDIR}/recipes-*/*/*.bb \
${LAYERDIR}/recipes-*/*/*.bbappend"

LAYERSERIES_COMPAT_hulks = "honister"

BBFILE_COLLECTIONS += "hulks"
BBFILE_PATTERN_hulks = "^${LAYERDIR}/"
BBFILE_PRIORITY_hulks = "9"
LAYERVERSION_hulks = "1"
```
